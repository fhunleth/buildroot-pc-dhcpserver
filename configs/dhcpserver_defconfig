## configs/dhcpserver_defconfig
```kconfig
BR2_x86_pentiumpro=y
BR2_JLEVEL=8
BR2_TARGET_GENERIC_HOSTNAME="dhcpserver"
BR2_TARGET_GENERIC_GETTY_PORT="tty1"
BR2_ROOTFS_POST_BUILD_SCRIPT="board/dhcpserver/post-build.sh"
# BR2_TARGET_ROOTFS_TAR is not set
BR2_TARGET_ROOTFS_ISO9660=y
BR2_TARGET_ROOTFS_ISO9660_BOOT_MENU="board/dhcpserver/grub-menu.lst"
BR2_LINUX_KERNEL=y
BR2_LINUX_KERNEL_CUSTOM_VERSION=y
BR2_LINUX_KERNEL_CUSTOM_VERSION_VALUE="3.2"
BR2_LINUX_KERNEL_USE_CUSTOM_CONFIG=y
BR2_LINUX_KERNEL_CUSTOM_CONFIG_FILE="board/qemu/x86/linux-3.2.config"
```
